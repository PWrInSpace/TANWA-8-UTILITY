## main/Kconfig.projbuild
```kconfig
menu "TANWA BOARD CONFIGURATION"

    menu "TASK CONFIGURATION"

        menu "SETUP TASK"

            config SETUP_TASK_STACK_SIZE
                int "Stack size"
                default 4096
                help
                    Stack size for setup task.

            config SETUP_TASK_PRIORITY
                int "Priority"
                default 5
                help
                    Priority for setup task.

            config SETUP_TASK_CORE_ID
                int "Core ID"
                default 0
                help
                    Core ID for setup task.

        endmenu

        menu "CAN TASK"

            config CAN_TASK_STACK_SIZE
                int "Stack size"
                default 4096
                help
                    Stack size for CAN task.

            config CAN_TASK_PRIORITY
                int "Priority"
                default 5
                help
                    Priority for CAN task.

            config CAN_TASK_CORE_ID
                int "Core ID"
                default 1
                help
                    Core ID for CAN task.

        endmenu

        menu "APP TASK"

            config APP_TASK_STACK_SIZE
                int "Stack size"
                default 4096
                help
                    Stack size for main task.

            config APP_TASK_PRIORITY
                int "Priority"
                default 5
                help
                    Priority for main task.

            config APP_TASK_CORE_ID
                int "Core ID"
                default 0
                help
                    Core ID for main task.

        endmenu

    endmenu

    menu "GPIO CONFIGURATION"

        config GPIO_LED
            int "LED GPIO"
            default 46
            help
                GPIO number for LED.

    endmenu

    menu "CAN CONFIGURATION"

        config CAN_RX_GPIO
            int "TWAI RX PIN"
            default 20
            help
                GPIO number for TWAI RX pin.

        config CAN_TX_GPIO
            int "CAN TX PIN"
            default 19
            help
                GPIO number for TWAI TX pin.

        config CAN_STB_GPIO
            int "CAN_STB GPIO pin"
            default 8

        config CAN_TX_QUEUE_LENGTH
            int "TX Queue Length"
            default 10
            help
                Length of the TX queue for CAN messages.

        config CAN_RX_QUEUE_LENGTH
            int "RX Queue Length"
            default 10
            help
                Length of the RX queue for CAN messages.

        config TWAI_ACCEPTANCE_CODE
            int "Acceptance Code"
            default 0
            help
                Acceptance code for TWAI filter.

        config TWAI_ACCEPTANCE_MASK
            int "Acceptance Mask"
            default 2147483647
            help
                Acceptance mask for TWAI filter.

    endmenu

    menu "Utility config"

        # LED and Buzzer

        config GPIO_LED_STRIP
            int "LED Strip Pin"
            default 9
            help
                GPIO connected to the LED strip

        config GPIO_BUZZER
            int "Buzzer Pin"
            default 10
            help
                GPIO for buzzer control

        config GPIO_LED_INTENS
            int "LED Intensity Control Pin"
            default 48
            help
                GPIO used for controlling LED intensity

        # Fans and Relay

        config GPIO_FAN1
            int "Fan #1 Pin"
            default 11
            help
                GPIO for first fan

        config GPIO_FAN2
            int "Fan #2 Pin"
            default 12
            help
                GPIO for second fan

        config GPIO_KONTRAKTON
            int "Kontrakton Pin"
            default 13
            help
                GPIO for kontaktor relay

        # Switch Inputs

        config GPIO_SWITCH_1
            int "Switch #1 Pin"
            default 18
            help
                GPIO connected to switch #1

        config GPIO_SWITCH_2
            int "Switch #2 Pin"
            default 17
            help
                GPIO connected to switch #2

        config GPIO_SWITCH_3
            int "Switch #3 Pin"
            default 16
            help
                GPIO connected to switch #3

        config GPIO_SWITCH_4
            int "Switch #4 Pin"
            default 15
            help
                GPIO connected to switch #4

        config GPIO_SWITCH_5
            int "Switch #5 Pin"
            default 7
            help
                GPIO connected to switch #5

        config GPIO_SWITCH_6
            int "Switch #6 Pin"
            default 37
            help
                GPIO connected to switch #6

        config GPIO_SWITCH_7
            int "Switch #7 Pin"
            default 36
            help
                GPIO connected to switch #7

        config GPIO_SWITCH_8
            int "Switch #8 Pin"
            default 35
            help
                GPIO connected to switch #8

        # I2C Interface

        config GPIO_I2C_SCL
            int "I2C SCL Pin"
            default 13
            help
                GPIO used for I2C Clock (SCL)

        config GPIO_I2C_SDA
            int "I2C SDA Pin"
            default 14
            help
                GPIO used for I2C Data (SDA)

    endmenu

endmenu
```
